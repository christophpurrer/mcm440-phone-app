## oe/mcm440-layer/conf/layer.conf
```bitbake
BBFILES += "${LAYERDIR}/recipes/*/*.bb"
BBPATH .= ":${LAYERDIR}"
BBFILE_COLLECTIONS += "mcm"
BBFILE_PRIORITY_mcm = "2"
BBFILE_PATTERN_mcm = "^${LAYERDIR}/"
```
